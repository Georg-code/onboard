## boards/arm/onboardx1/Kconfig.board
```kconfig
# Copyright (c) 2024 Nordic Semiconductor ASA
# SPDX-License-Identifier: Apache-2.0

config BOARD_ONBOARDX1
	bool "OnBoardX1"
	depends on SOC_NRF52820_QDAA
```
